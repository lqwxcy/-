/*********************************************************** 
文件名称： DS18b20函数
作 者：    LQW
版 本：    0.01
说 明：    
时间 ：    2012年12月19日20:50:58
修改记录：
总结 ：   	
***********************************************************/
#include"delay.h"
#include"ds18b20.h"
#include"ds18b20alarm.h"
/*------------------------------------------
 	ds18b20控制管脚定义
-------------------------------------------*/
sbit DQ = P2^3;

/*------------------------------------------
 	定义操作变量
-------------------------------------------*/
u8 Temp_Value[] = { 0x00,0x00 }; //定义一个数据来存储所读取的温度值
bit iS_DS18B20_OK = 1;
/*********************************************************** 
函数名称： 	 u8 Init_DS18B20())
函数功能： 	 ds18b20初始化		   
入口参数： 	 
出口参数： 	 state值为0读取器件成功，否则失败
备 注： 
***********************************************************/
u8 Init_DS18B20()
{
	u8 state; //定义读到器件发到信号DQ = 0说明有器件存在，信号 = 1说明读器件失败
	DQ = 1;
	DelayUs( 8 );//稍作延迟
	DQ = 0;
	DelayUs( 80 );//延迟时间要求为480us-960us
	DQ = 1; //释放数据线
	DelayUs( 8 );//要求延迟时间为15us-60us
	state = DQ;//读取DQ的值，为1没有器件存在，0就有器件存在
	DelayUs( 4 );//稍作延迟
	DQ = 1;	  //最后释放总线
	return state; 
}

/*********************************************************** 
函数名称： 	 void ds18b20_Write_A_Byte( u8 dat )
函数功能： 	 向DS18B20写一个字节数据		   
入口参数： 	 dat是自己想写入ds18b20里面的数据
出口参数： 	 
备 注： 
***********************************************************/
void ds18b20_Write_A_Byte( u8 dat )
{
	u8 i;
	for( i = 0; i < 8; i++ )
	{
		DQ = 0;
		DQ = dat & 0x01;//数据按低位到高位发送
		DelayUs( 10);
		DQ = 1;
		dat  = dat >> 1;
	}
	DelayUs( 4 );//稍作延迟	
}

/*********************************************************** 
函数名称： 	 u8 ds18b20_Read_A_Byte()
函数功能： 	 从DS18B20读取一个字节数据		   
入口参数： 	 
出口参数： 	 dat是从ds18b20里面读到的数据
备 注： 
***********************************************************/
u8 ds18b20_Read_A_Byte()
{
	u8 dat;
	u8 i;
	for( i = 0; i < 8; i++ )
	{
		DQ = 0;
		dat = dat >> 1;	//先把数据右移出来再读取
		DQ = 1;
		if( DQ )
			dat = dat | 0x80;
		DelayUs( 10 );
		DQ = 1; //释放总线读取下一个数据
	}
	return dat;
}

/*********************************************************** 
函数名称： 	 void ds18b20_ReadTemperature()
函数功能： 	 读取温度值分别放在Temp_Value[]（存放温度值）与Temp_Alarm[]（存放报警值
）两个数组		   
入口参数： 	 
出口参数： 	 dat是从ds18b20里面读到的数据
备 注： 
***********************************************************/
void ds18b20_ReadTemperature()
{
	if( Init_DS18B20() == 1 ) //Init_DS18B20()判断函数返回值是否为0，为1则读取失败：iS_DS18B20_OK = 0;，
	{
		iS_DS18B20_OK = 0;
	}
	else
	{
		ds18b20_Write_A_Byte( 0xCC );//跳过ROM
		ds18b20_Write_A_Byte( 0x44 );//启动温度转换	
		//DelayUs( 200 );
			
		Init_DS18B20();//ds1820初始化
		ds18b20_Write_A_Byte( 0xCC );//跳过ROM
		ds18b20_Write_A_Byte( 0xBE );//单片机读DS18B20内部RAM中 9个字节的温度数据（就是把ds18b20RAM中数据发送到单片机）
		
		Temp_Value[ 0 ] = ds18b20_Read_A_Byte();//先读取低位
		Temp_Value[ 1 ] = ds18b20_Read_A_Byte();//再读取高位	
		
		Alarm_Temp[ 0 ] = ds18b20_Read_A_Byte();//设置温度报警值上限
		Alarm_Temp[ 1 ]	= ds18b20_Read_A_Byte();//设置温度报警值下限
		iS_DS18B20_OK  = 1;	
	}	
}

/*********************************************************** 
函数名称： 	 void Set_DS18B20_Alarm_Temp()
函数功能： 	 设置DS18B20温度的报警值，且写入ds18b20里
）两个数组		   
入口参数： 	 
出口参数： 	 
备 注： 
***********************************************************/
void Set_DS18B20_Alarm_Temp()
{
	Init_DS18B20();
	ds18b20_Write_A_Byte( 0xCC );//跳过ROM	
	ds18b20_Write_A_Byte( 0x4E );//写暂存器，把报警温度的值写进2，3个字节里面
	ds18b20_Write_A_Byte(  Alarm_Temp[ 0 ] );//写温度的上限	
	ds18b20_Write_A_Byte(  Alarm_Temp[ 1 ] );//写温度的下限
	ds18b20_Write_A_Byte( 0x7f );//12位精度

	Init_DS18B20();
	ds18b20_Write_A_Byte( 0xCC );//跳过ROM	
	ds18b20_Write_A_Byte( 0x48 );//将温度报警器的值存入DS18B20	
}





