/*********************************************************** 
文件名称： LCD12864驱动程序
作 者：    LQW
版 本：    0.01
说 明：    
时间 ：    2012年12月12日20:24:24
修改记录：
总结 ：   	
***********************************************************/
#include"LCD12864.h"
#include"delay.h"
#include<intrins.h>

/*------------------------------------------
 	LCD12864液晶控制管脚定义
-------------------------------------------*/
sbit RS = P2^0;	 //模式位，为0 输入指令，为1输入数据
sbit RW = P2^1;	 //读写位，为0读，1为写
sbit EN = P2^2;	 //使能端
sbit PSB = P2^7; //高电平为数据并行传输，低电平为串行传输
sbit Busy = P0^7; //液晶忙标志

/*------------------------------------------
 	定义数据端口
-------------------------------------------*/
#define DataPort P0	 //数据总线

/*********************************************************** 
函数名称： 	 void Check_Busy()
函数功能： 	 液晶等待		   
入口参数： 	 无 
出口参数： 	  
备 注： 
***********************************************************/
void Check_Busy()  //检查忙碌（底层函数）
{
	do
	{
		RS = 0;	  //检测液晶忙是读取液晶状态
		RW = 1;
		EN = 0;
		_nop_();
		EN = 1;
	}while( Busy == 1 ); //如果P0^7等于1，表示液晶在进行内部操作，不接受外部指令
	EN = 0; //释放使能	
}

/*********************************************************** 
函数名称： 	 void Write_Com( u8 com )
函数功能： 	 写液晶指令		   
入口参数： 	 com 
出口参数： 	  
备 注： 
***********************************************************/
void Write_Com( u8 com ) //写命令到LCD12864( 底层函数 )
{
	Check_Busy();//检测液晶忙碌
	RS = 0;
	RW = 0;
	DataPort = com;
	EN = 1;
	_nop_();
	_nop_();
	_nop_();
	EN = 0;
}

/*********************************************************** 
函数名称： 	 void Write_Data( u8 dat )
函数功能： 	 写数据到液晶指   
入口参数： 	 dat 
出口参数： 	  
备 注： 
***********************************************************/
void Write_Data( u8 dat ) //写数据到LCD12864( 底层函数 )
{
	Check_Busy();//检测液晶忙碌
	RS = 1;
	RW = 0;
	DataPort = dat;	 //准备好数据
	EN = 1;			 //使能从高电平变成低电平，数据就被送到液晶里面
	_nop_();
	_nop_();
	_nop_();
	EN = 0;	
}

/*********************************************************** 
函数名称： 	 void Init_LCD12864()
函数功能： 	 液晶初始化  
入口参数： 	 无 
出口参数： 	  
备 注： 
***********************************************************/
void Init_LCD12864() //被调用层函数
{
	DelayMs( 40 ); //进来延迟40ms
	PSB = 1;	  //设置为并行工作模式
	DelayMs( 1);
	Write_Com( 0x30 ); //设置基本指令
	DelayMs( 50 );
	Write_Com( 0x30 ); //设置8bit数据传送
	DelayMs( 50 );	   // 延迟时间大于37US
	Write_Com( 0x0c ); //开显示
	DelayMs( 50 ); //要大于100us
	Write_Com( 0x01 ); //清屏
	DelayMs( 20 ); //要大于10us
	Write_Com( 0x06 );////指定在资料的读取及写入时，设定游标的移动方向及指定显示的移位，光标从右向左加1位移动
	DelayMs( 50 );	
}

/*********************************************************** 
函数名称： 	 void  DisplayCGRAM( u8 x, u8 y )
函数功能： 	 显示用户自定义字符，指定的位置显示
入口参数： 	 x表示是从第几个字符开始显示，y表示是纵坐标 
出口参数： 	  
备 注： 
***********************************************************/
void  DisplayCGRAM( u8 x, u8 y )  //被调用层函数
{
	u8 address;
	switch( y )	  //y表示是纵坐标
	{
		case 1: address = 0x80 + x; break;
		case 2: address = 0x90 + x; break;
		case 3: address = 0x88 + x; break;
		case 4: address = 0x98 + x; break;
		default: break;
	}
	Write_Com( address );
}

/*********************************************************** 
函数名称： 	 void LCD_PutString(u8 x, u8 y, u8 8s )
函数功能： 	 显示用户自定义字符串，指定的位置显示
入口参数： 	 x表示是从第几个字符开始显示，y表示是纵坐标 
出口参数： 	  
备 注： 
***********************************************************/
void LCD_PutString( u8 x, u8 y, u8 *s )	 //如果写成DisplayGCRAMStr()函数有还有错误 
{
	DisplayCGRAM(  x, y ); //地址转换

	while( *s != '\0' )	
	{
		Write_Data( *s );  //应用：LCD_PutString( 0, 1, "嘻嘻" );直接显示：嘻嘻
		s++;
		DelayUs( 50 ); //这里的延迟起到所显示内容一个一个显示（时间长，显示慢）
	}
} 










